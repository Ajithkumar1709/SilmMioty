/**
 * @cliArgs --board "/ti/boards/CC1352R1_LAUNCHXL" --product "simplelink_cc13xx_cc26xx_sdk@5.30.01.01"
 * @versions {"tool":"1.19.0+3426"}
 */

/**
 * Import the modules used in this configuration.
 */
const CCFG     = scripting.addModule("/ti/devices/CCFG");
const Display  = scripting.addModule("/ti/display/Display", {}, false);
const Display1 = Display.addInstance();
const ADC      = scripting.addModule("/ti/drivers/ADC", {}, false);
const ADC1     = ADC.addInstance();
const ADC2     = ADC.addInstance();
const ADC3     = ADC.addInstance();
const ADC4     = ADC.addInstance();
const AESECB   = scripting.addModule("/ti/drivers/AESECB", {}, false);
const AESECB1  = AESECB.addInstance();
const GPIO     = scripting.addModule("/ti/drivers/GPIO", {}, false);
const GPIO7    = GPIO.addInstance();
const GPIO8    = GPIO.addInstance();
const GPIO9    = GPIO.addInstance();
const GPIO14   = GPIO.addInstance();
const NVS      = scripting.addModule("/ti/drivers/NVS", {}, false);
const NVS1     = NVS.addInstance();
const RF       = scripting.addModule("/ti/drivers/RF");
const RTOS     = scripting.addModule("/ti/drivers/RTOS");
const SPI      = scripting.addModule("/ti/drivers/SPI", {}, false);
const SPI1     = SPI.addInstance();
const UART     = scripting.addModule("/ti/drivers/UART", {}, false);
const UART1    = UART.addInstance();

/**
 * Write custom configuration values to the imported modules.
 */
CCFG.enableBootloaderBackdoor = true;
CCFG.dioBootloaderBackdoor    = 15;
CCFG.levelBootloaderBackdoor  = "Active low";
CCFG.forceVddr                = true;
CCFG.ccfgTemplate.$name       = "ti_devices_CCFGTemplate0";

Display1.$name       = "CONFIG_Display_0";
Display1.displayType = "Host";

ADC1.$name              = "currentAdcDIO23";
ADC1.adc.$assign        = "ADC0";
ADC1.adc.adcPin.$assign = "boosterpack.2";

ADC2.$name              = "volatgeAdcDIO24";
ADC2.adc.$assign        = "ADC0";
ADC2.adc.adcPin.$assign = "boosterpack.6";

ADC3.$name              = "panelVolageAdcDIO28";
ADC3.adc.$assign        = "ADC0";
ADC3.adc.adcPin.$assign = "boosterpack.26";

ADC4.$name              = "batterySenseAdcDIO29";
ADC4.adc.$assign        = "ADC0";
ADC4.adc.adcPin.$assign = "boosterpack.27";

AESECB1.$name = "CONFIG_AESECB_0";

GPIO7.$name           = "CONFIG_CC1190_PA_EN_DIO3";
GPIO7.mode            = "Output";
GPIO7.gpioPin.$assign = "boosterpack.19";

GPIO8.$name           = "CONFIG_CC1190_LNA_EN_DIO4";
GPIO8.mode            = "Output";
GPIO8.gpioPin.$assign = "boosterpack.9";

GPIO9.$name           = "CONFIG_CC1190_HGM_DIO5";
GPIO9.mode            = "Output";
GPIO9.gpioPin.$assign = "boosterpack.10";

GPIO14.mode            = "Output";
GPIO14.$name           = "checkingDIO17";
GPIO14.gpioPin.$assign = "boosterpack.31";

NVS1.$name                    = "CONFIG_NVSEXTERNAL";
NVS1.nvsType                  = "External";
NVS1.externalFlash.$name      = "ti_drivers_nvs_NVSSPI25X0";
NVS1.externalFlash.regionSize = 0x200000;

const Power             = scripting.addModule("/ti/drivers/Power", {}, false);
Power.calibrateFunction = "PowerCC26XX_noCalibrate";
Power.calibrateRCOSC_LF = false;
Power.calibrateRCOSC_HF = false;

UART1.$name               = "CONFIG_UART_0";
UART1.$hardware           = system.deviceData.board.components.XDS110UART;
UART1.txPinInstance.$name = "CONFIG_PIN_2";
UART1.rxPinInstance.$name = "CONFIG_PIN_3";

const NVSSPI25XDevice                         = scripting.addModule("/ti/drivers/nvs/NVSSPI25XDevice", {}, false);
const NVSSPI25XDevice1                        = NVSSPI25XDevice.addInstance({}, false);
NVSSPI25XDevice1.$name                        = "CONFIG_NVS_SPI_0";
NVS1.externalFlash.spiFlashDevice             = NVSSPI25XDevice1;
NVSSPI25XDevice1.bitRate                      = 5000000;
NVSSPI25XDevice1.slaveSelect.$assign          = "boosterpack.5";
NVSSPI25XDevice1.slaveSelectPinInstance.$name = "CONFIG_GPIO_0";

SPI1.$name                         = "CONFIG_SPI_0";
NVSSPI25XDevice1.sharedSpiInstance = SPI1;
SPI1.spi.$assign                   = "SSI0";
SPI1.spi.sclkPin.$assign           = "boosterpack.38";
SPI1.spi.misoPin.$assign           = "boosterpack.8";
SPI1.spi.mosiPin.$assign           = "boosterpack.37";
scripting.suppress("Connected to hardware,@@@.+?@@@ is connected to MX25R8035F SPI Flash Slave Select on the CC1352R1 LaunchPad\\. Consider selecting it in 'use hardware' above\\. @@@.+?@@@", SPI1.spi, "sclkPin");

/**
 * Pinmux solution for unlocked pins/peripherals. This ensures that minor changes to the automatic solver in a future
 * version of the tool will not impact the pinmux you originally saw.  These lines can be completely deleted in order to
 * re-solve from scratch.
 */
UART1.uart.$suggestSolution            = "UART0";
UART1.uart.txPin.$suggestSolution      = "boosterpack.4";
UART1.uart.rxPin.$suggestSolution      = "boosterpack.3";
SPI1.spi.dmaRxChannel.$suggestSolution = "DMA_CH3";
SPI1.spi.dmaTxChannel.$suggestSolution = "DMA_CH4";
